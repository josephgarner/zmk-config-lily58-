## boards/shields/ergo_s1_oe/Kconfig.defconfig
```kconfig
# Copyright (c) 2021 The ZMK Contributors
# SPDX-License-Identifier: MIT


if SHIELD_ERGO_S1_OE_DONGLE_PRO_MICRO || SHIELD_ERGO_S1_OE_LEFT

config ZMK_KEYBOARD_NAME
    default "Ergo S-1"

config ZMK_SPLIT_ROLE_CENTRAL
    default y

config ZMK_SPLIT
    default y

endif


if SHIELD_ERGO_S1_OE_DONGLE_PRO_MICRO || SHIELD_ERGO_S1_OE_LEFT || SHIELD_ERGO_S1_OE_RIGHT || SHIELD_ERGO_S1_OE_LEFT_PERIPHERAL

config ZMK_SPLIT
    default y

if ZMK_DISPLAY

config I2C
    default y


endif # ZMK_DISPLAY

endif
```

## boards/shields/ergo_s1_oe/Kconfig.shield
```kconfig
# Copyright (c) 2021 The ZMK Contributors
# SPDX-License-Identifier: MIT

config SHIELD_ERGO_S1_OE_LEFT
    def_bool $(shields_list_contains,ergo_s1_oe_left)

config SHIELD_ERGO_S1_OE_RIGHT
    def_bool $(shields_list_contains,ergo_s1_oe_right)

config SHIELD_ERGO_S1_OE_DONGLE_PRO_MICRO
    def_bool $(shields_list_contains,ergo_s1_oe_dongle_pro_micro)
```
